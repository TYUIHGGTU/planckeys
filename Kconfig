## Kconfig
```kconfig
# SPDX-License-Identifier: MIT
# 仓库根 ZMK 模块配置：自研 WS2812 灯带控制（网页每颗 RGB + 预设灯效）。

config PLANCKEYS_LED_CONTROL
	bool "planckeys web-controlled WS2812 LED (takes over the strip)"
	depends on !ZMK_SPLIT || ZMK_SPLIT_ROLE_CENTRAL
	select RAW_HID
	select LED_STRIP
	help
	  自研模块独占 zmk,underglow 指向的 WS2812 灯带：
	  - 主机经 Raw HID (usage page 0xFF60) 下发每颗独立 RGB / 纯色 / 亮度；
	  - 内建预设灯效：常亮 / 呼吸 / 跑马 / 熔灭 / 关灯；
	  - keymap 里的 &led_next 键循环切换上述预设。
	  使用前请在 <board>.conf 里关闭 CONFIG_ZMK_RGB_UNDERGLOW，避免两者
	  争抢同一条灯带。

if PLANCKEYS_LED_CONTROL

config PLANCKEYS_LED_DEFAULT_BRIGHTNESS
	int "Default brightness (0-255)"
	default 80

config PLANCKEYS_LED_AXIS_START
	int "Chain index where the per-key (axis) LEDs start"
	default 6
	help
	  已确认布局（单条链 28 颗）：index 0..5 为底灯（正面不可见），
	  index 6..27 为每键轴灯。此值仅用于日志/观感（如跑马方向），
	  不影响基础功能。

config PLANCKEYS_LED_FRAME_MS
	int "Animation frame period in milliseconds"
	default 33

endif # PLANCKEYS_LED_CONTROL
```

## config/boards/arm/planck/Kconfig.defconfig
```kconfig
# Electronut Labs Papyr board configuration

# Copyright (c) 2020 The ZMK Contributors
# SPDX-License-Identifier: MIT

if BOARD_PLANCK_LEFT

config ZMK_KEYBOARD_NAME
		default "PlanckKeys L"

endif

if BOARD_PLANCK_RIGHT

config ZMK_KEYBOARD_NAME
		default "PlanckKeys R"

endif

if BOARD_PLANCK_LEFT || BOARD_PLANCK_RIGHT
#
# config BOARD
# 		default "AU"

# 两块板已改造为各自独立的完整键盘（不再是左主右从分体），
# 因此不再开启 ZMK_SPLIT / ZMK_SPLIT_ROLE_CENTRAL。

config BT_CTLR
		default BT

if USB

config USB_NRFX
    default y

config USB_DEVICE_STACK
    default y

endif # USB

if ZMK_DISPLAY

# config I2C
#     default y
#
# config SSD1306
#     default y

# config LPM009M360A
# 	default n
endif # ZMK_DISPLAY


if LVGL
config ZMK_DISPLAY_DEDICATED_THREAD_STACK_SIZE
	default 8192

#config LV_HOR_RES_MAX
	#default 128
#config LV_VER_RES_MAX
	#default 32
config LV_Z_VDB_SIZE
	default 64

config LV_DPI_DEF
	default 148
config LV_Z_BITS_PER_PIXEL
	default 1
choice LV_COLOR_DEPTH
	default LV_COLOR_DEPTH_1
endchoice

endif # LVGL

# config ZMK_WIDGET_WPM_STATUS
# 	default y
choice BOARD_CHARGER_CURRENT
    default BOARD_CHARGER_CURRENT_100MA
endchoice

config I2C
	default y
config SPI
	default y

endif 
```

## config/west.yml
```yaml
manifest:
  remotes:
    - name: zmk
      url-base: https://github.com/zmkfirmware
    - name: badjeff
      url-base: https://github.com/badjeff
    - name: yangxing
      url-base: https://github.com/yangxing844
    - name: zzeneg  # host <-> keyboard raw HID (0xFF60)，供左板网页控灯
      url-base: https://github.com/zzeneg
  projects:
    - name: zmk
      remote: zmk
      revision: main
      import: app/west.yml
    - name: zmk-pmw3610-driver
      remote: badjeff
      revision: main
    - name: zmk-split-peripheral-input-relay
      remote: badjeff
      revision: main
    - name: zmk-input-behavior-listener
      remote: badjeff
      revision: main
    - name: zmk-lpm009m360a-driver
      remote: yangxing
      revision: master
    - name: zmk-raw-hid
      remote: zzeneg
      revision: main
  self:
    path: config
```

## dts/bindings/behaviors/planckeys,behavior-led-next.yaml
```yaml
# SPDX-License-Identifier: MIT
description: |
  Cycle the self-developed WS2812 LED presets (solid -> breathing -> marquee ->
  fade -> off -> ...). Zero-parameter behavior; the actual strip is driven by the
  planckeys-led-control module (src/led_control.c).

compatible: "planckeys,behavior-led-next"

include: zero_param.yaml
```
